## arch/mips/mach-xburst/Kconfig
```kconfig
menu "Ingenic Xburst platforms"
	depends on ARCH_XBURST

config SYS_VENDOR
	default "ingenic"

config SYS_SOC
        default "PRJ" if SOC_PRJ

choice
	prompt "Ingenic Xburst SoC select"

config SOC_PRJ
	bool "PRJ"
	select SYS_CACHE_SHIFT_5
	select SYS_MIPS_CACHE_INIT_RAM_LOAD
	select PINCTRL_INGENIC
	# select INGENIC_SERIAL
	select MISC
	select SPL_SEPARATE_BSS if SPL
	select SPL_LOADER_SUPPORT if SPL
	select SPL_OF_CONTROL if SPL_DM
	select SPL_OF_PLATDATA if SPL_DM
	select SPL_DM_SERIAL if SPL_DM
	help
	  This supports Ingenic PRJ.

endchoice

source "arch/mips/mach-xburst/PRJ/Kconfig"

config WARN_ERROR
    bool "Treat warnings as errors"
    default y
    help
      If enabled, all compiler warnings will be treated as errors.

endmenu
```

## arch/mips/mach-xburst/PRJ/Kconfig
```kconfig
if SOC_PRJ

config SYS_DCACHE_SIZE
    default 32768    #(32K)

config SYS_DCACHE_LINE_SIZE
    default 32

config SYS_DCACHE_WAYS
    default 8

config SYS_ICACHE_SIZE
    default 32768    #(32K)

config SYS_ICACHE_LINE_SIZE
    default 32

config SYS_ICACHE_WAYS
        default 8

config SYS_SCACHE_SIZE
    default 131072    #(128K)

config SYS_SCACHE_LINE_SIZE
        default 32

config SYS_SCACHE_WAYS
        default 8

config BOARD_SCACHE
    def_bool y

config SPL_TEXT_BASE
    default 0x80001000

config SPL_BSS_START_ADDR
    default 0x8001f000

config SPL_SIZE_LIMIT
    hex
    default 0x19000 #(100K)

config MAX_MEM_SIZE
    int
    default 256

config SYS_TEXT_BASE
        hex
    default 0x80400000


config SOCID_ADDRESS
        hex
    default 0xb300002c

config SOCID_PRJ007
        hex
    default 0x10032004

config SOCID_PRJ008
        hex
    default 0x10033004


choice
    prompt "PRJ SoC Select"
    default PRJ008

config PRJ007
        bool "PRJ007 Series"

config PRJ008
        bool "PRJ008 Series"
endchoice

choice
    prompt "PRJ SoC Type Select"
    default PRJ_NQ

config PRJ_N
        bool "PRJ-N"
        depends on PRJ008

config PRJ_NQ
        bool "PRJ-NQ"
        depends on PRJ007

config PRJ_ZN
        bool "PRJ-ZN"
        depends on PRJ008 || PRJ007

config PRJ_VN
        bool "PRJ-VN"
        depends on PRJ008 || PRJ007

config PRJ_VNP
        bool "PRJ-VNP"
        depends on PRJ008 || PRJ007

config PRJ_XQ
        bool "PRJ-XQ"
        depends on PRJ007

config PRJ_ZX
        bool "PRJ-ZX"
        depends on PRJ007

config PRJ_VX
        bool "PRJ-VX"
        depends on PRJ007

config PRJ_L
        bool "PRJ-L"
        depends on PRJ008

config PRJ_DL
        bool "PRJ-DL"
        depends on PRJ008

config PRJ_LQ
        bool "PRJ-LQ"
        depends on PRJ007

config PRJ_ZL
        bool "PRJ-ZL"
        depends on PRJ008 || PRJ007

config PRJ_VL
        bool "PRJ-VL"
        depends on PRJ008 || PRJ007

config PRJ_A
        bool "PRJ-A"
        depends on PRJ007

endchoice


config DDR_PARAMS_STRUCT
    bool "Support multiple DDR (Dynamic Random Access Memory) types"
    def_bool y

menu "DDR Training Config"
    comment "Select training method(s)"

config DDR_SOFT_TRAIN
    bool "SOFT_TRAIN"

config DDR_HARDWARE_TRAIN
    bool "HARDWARE_TRAIN"
endmenu

menu "DDR Chip Model Select"
    comment "Select one or more DDR models"

config DDR3_W631GU6NG
    tristate "DDR3 W631GU6NG"

config DDR3_NK5CC64M16HQ3
    tristate "DDR3 NK5CC64M16HQ3"

config DDR3_W632GU6NG
    tristate "DDR3 W632GU6NG"

config DDR2_W9751V6NG
    tristate "DDR2 W9751V6NG"

config DDR2_M14D5121632A
    tristate "DDR2 M14D5121632A"

config LPDDR3_W63AH6N2B_BJ
    tristate "LPDDR3 W63AH6N2B-BJ"

endmenu


menu "DDR Type Select"
    comment "Select DDR type(s)"

config DDR_TYPE_DDR3
    bool "DDR3"
    depends on DDR3_W631GU6NG || DDR3_NK5CC64M16HQ3 || DDR3_W632GU6NG

config DDR_TYPE_DDR2
    bool "DDR2"
    depends on DDR2_W9751V6NG || DDR2_M14D5121632A


config DDR_TYPE_LPDDR3
    bool "LPDDR3"
	depends on LPDDR3_W63AH6N2B_BJ

endmenu



source "board/ingenic/PRJ/Kconfig"

endif
```

## board/ingenic/PRJ/Kconfig
```kconfig
if SOC_PRJ

config SYS_BOARD
	default "PRJ"

config SYS_CONFIG_NAME
	default "PRJ"

config PRJ
	def_bool y

config SYS_APLL_FREQ
	int "apll frequency"
	default 1200000000
	help
	 If APLL not use mast be set 0

config SYS_MPLL_FREQ
	int "mpll frequency"
	default 900000000
	help
	 If MPLL not use mast be set 0

config SYS_VPLL_FREQ
	int "vpll frequency"
	default 1188000000
	help
	 If VPLL not use mast be set 0

config SYS_CPU_FREQ
	int "cpu frequency"
	default 1200000000


config SYS_MEM_FREQ
	int "ddr frequency"
	default 450000000


config SYS_EXTAL
	int
	default 24000000        #EXTAL freq: 24 MHz

# config SYS_TIMER_RATE
	# int
	# default 24000000        #EXTAL freq: 24 MHz

config SYS_HZ
	int
	default 1000            #incrementer freq

config SYS_UART_INDEX
	int "### uart index"
	default 1

config BAUDRATE
	int
	default 115200

endif
```

## common/spl_ingenic/Kconfig
```kconfig
menuconfig INGENIC_SPL
	bool "Ingenic SPL Boot options"
	depends on SPL_FRAMEWORK

if INGENIC_SPL
choice
	prompt "SPL Boot Medium Select"
	default SPL_MMC_SUPPORT

config SPL_MMC_SUPPORT
	bool "SPL MMC Boot"


config SPL_SFC_SUPPORT
	bool "SPL SFC Boot"

endchoice


if SPL_MMC_SUPPORT
choice
	prompt "MSC Controller Select"
	default SPL_JZ_MSC0

config SPL_JZ_MSC0
	bool "MSC Controller 0"

config SPL_JZ_MSC1
	bool "MSC Controller 1"

endchoice


choice
	prompt "MSC Bus Width Select"

config SPL_JZ_MSC_BUS_1BIT
	bool "MSC 1-bit bus width"

config SPL_JZ_MSC_BUS_4BIT
	bool "MSC 4-bit bus width"

config SPL_JZ_MSC_BUS_8BIT
	bool "MSC 8-bit bus width"

endchoice

config SPL_JZ_MSC_DMA_ENABLE
	bool "MSC DMA Enable"

config JZ_MMC_MSC0_PB_4BIT
	bool "MSC0 Used GPIOB"
	depends on SPL_JZ_MSC0

config JZ_MMC_MSC1_PC
	bool "MSC1 Used GPIOC"
	depends on SPL_JZ_MSC1

config STORAGE_REDUCE_MMC
	bool "Skip MMC detection"

config STORAGE_REDUCE_SD
	bool "Skip SD detection"

config GPT_TAB_BUILT_IN
	bool
	depends on SPL_MMC_SUPPORT && SPL_OS_BOOT
	default y

config GPT_CREATOR
	bool
	default y

endif #SPL_MMC_SUPPORT

if SPL_SFC_SUPPORT
choice
	prompt "SFC Flash Type Select"
	default SPL_SFC_NOR_SUPPORT

config SPL_SFC_NOR_SUPPORT
	bool "SPL SFC NOR Boot"

config SPL_SFC_NAND_SUPPORT
	bool "SPL SFC NAND Boot"

endchoice
endif #SPL_SFC_SUPPORT


endif #INGENIC_SPL
```

## tools/ingenic-tools/Kconfig
```kconfig
menuconfig INGENIC_TOOLS
	bool "Ingenic Tools"
	default y
	imply INGENIC_TOOL_SPL_PARAMS_FIXER
	imply INGENIC_TOOL_SPI_CHECKSUM
	imply INGENIC_TOOL_DDR_CREATOR
	imply INGENIC_TOOL_CLK_PARAMS_CREATOR
	imply INGENIC_TOOL_PLL_PARAMS_CREATOR
	imply INGENIC_TOOL_SFC_TOOLS
	imply INGENIC_TOOL_MMC_TOOLS

if INGENIC_TOOLS


config INGENIC_TOOL_SPL_PARAMS_FIXER
	bool "Enable ingenic tool spl_params_fixer"

config INGENIC_TOOL_SPL_CHECKSUM
	bool "Enable ingenic tool spl_checksum"

config INGENIC_TOOL_MMC_TOOLS
	bool "Enable ingenic tool mmc_tools"
	depends on SPL_MMC_SUPPORT

config INGENIC_TOOL_CLK_PARAMS_CREATOR
	bool "Enable ingenic tool clk_params_creator"

config INGENIC_TOOL_PLL_PARAMS_CREATOR
	bool "Enable ingenic tool pll_params_creator"

config INGENIC_TOOL_DDR_CREATOR
	bool "Enable ingenic tool ddr_creator"
	help
	  Enable ingenic tool ddr_creator
	  to generate include/generated/ddr_reg_values.h file

# 需要使用吗？
config INGENIC_TOOL_SFC_TOOLS
	bool "Enable ingenic tool sfc_tools"
	depends on SPL_SFC_NAND_SUPPORT || SPL_SFC_NOR_SUPPORT
	help
	  Enable ingenic tool sfc_tools
	  to generate "sfc_nand_params.h" and "sfc_timing_val.h" file in include/generated/

config INGENIC_TOOL_SPL_PAD_TO_BLOCK
	bool "Enable ingenic toolspl pad to block"

endif
```
